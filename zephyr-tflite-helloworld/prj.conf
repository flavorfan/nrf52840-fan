## CMakeLists.txt
```
# SPDX-License-Identifier: Apache-2.0

cmake_minimum_required(VERSION 3.13.1)
find_package(Zephyr HINTS $ENV{ZEPHYR_BASE})
project(external_lib)

#target_sources(app PRIVATE src/hello_world_test.cc)
target_sources(app PRIVATE src/main.cc)
target_sources(app PRIVATE src/main_functions.cc)
target_sources(app PRIVATE src/constants.cc)
target_sources(app PRIVATE src/output_handler.cc)
target_sources(app PRIVATE src/model.cc)
target_sources(app PRIVATE src/assert.cc)

zephyr_include_directories(src)

# Create a wrapper CMake library that our app can link with
set(TF_LIB_DIR     ${CMAKE_CURRENT_SOURCE_DIR}/lib)
set(THIRD_PARTY_DIR     ${TF_LIB_DIR}/third_party)

add_library(tf_lib STATIC IMPORTED GLOBAL)

set_target_properties(tf_lib PROPERTIES IMPORTED_LOCATION             ${TF_LIB_DIR}/libtensorflow-microlite.a)
set_target_properties(tf_lib PROPERTIES INTERFACE_INCLUDE_DIRECTORIES "${TF_LIB_DIR};${TF_LIB_DIR}/tensorflow/lite/micro;${THIRD_PARTY_DIR}/flatbuffers/include") 

target_link_libraries(app PUBLIC tf_lib)
```

## prj.conf
```kconfig
CONFIG_STDOUT_CONSOLE=y
CONFIG_CPLUSPLUS=y
CONFIG_STD_CPP11=y
CONFIG_NEWLIB_LIBC=y
CONFIG_FPU=y
CONFIG_FP_SOFTABI=y
CONFIG_LIB_CPLUSPLUS=y

CONFIG_HEAP_MEM_POOL_SIZE=16384
CONFIG_MAIN_STACK_SIZE=8192
CONFIG_SYSTEM_WORKQUEUE_STACK_SIZE=8192

CONFIG_PRINTK=y
# CONFIG_PWM=y
```

## src/output_handler.cc
```c
/* Copyright 2019 The TensorFlow Authors. All Rights Reserved.

Licensed under the Apache License, Version 2.0 (the "License");
you may not use this file except in compliance with the License.
You may obtain a copy of the License at

    http://www.apache.org/licenses/LICENSE-2.0

Unless required by applicable law or agreed to in writing, software
distributed under the License is distributed on an "AS IS" BASIS,
WITHOUT WARRANTIES OR CONDITIONS OF ANY KIND, either express or implied.
See the License for the specific language governing permissions and
limitations under the License.
==============================================================================*/

#include "output_handler.h"

#include <zephyr.h>
#include <sys/printk.h>
#include <device.h>
#include <drivers/pwm.h>


#define PWM_LED0_NODE	DT_ALIAS(pwm_led0)
#define FLAGS_OR_ZERO(node)                                                    \
	COND_CODE_1(DT_PHA_HAS_CELL(node, pwms, flags), (DT_PWMS_FLAGS(node)), \
		    (0))

// #define PWM_LABEL DT_PWMS_LABEL(PWM_LED0_NODE)
#define PWM_CHANNEL DT_PWMS_CHANNEL(PWM_LED0_NODE)
#define PWM_FLAGS FLAGS_OR_ZERO(PWM_LED0_NODE)

#define MIN_PERIOD_USEC (USEC_PER_SEC / 64U)

// struct device *pwm;
static uint32_t period;
static uint32_t new_period;

void outputInit()
{
	// pwm = device_get_binding(PWM_LABEL);
	// if (!pwm) {
	// 	printk("Error: didn't find %s device\n", PWM_LABEL);
	// 	return;
	// }

	// period = MIN_PERIOD_USEC;
}

void HandleOutput(tflite::ErrorReporter *error_reporter, float x_value,
		  float y_value)
{
// new_period = (uint32_t)((period * (y_value + 1) )/2);
//     if( new_period >= period){
//         new_period = period;
//     } 
    
	
	// Log the current X and Y values

    // pwm_pin_set_usec(pwm, PWM_CHANNEL, period, new_period , PWM_FLAGS);
 	TF_LITE_REPORT_ERROR(error_reporter, "x_value: %f, y_value: %f\n",
			     static_cast<double>(x_value),
			     static_cast<double>(y_value));  
}
```
